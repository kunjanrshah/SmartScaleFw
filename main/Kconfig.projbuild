## main/Kconfig.projbuild
```kconfig
menu "Example 'GATT SERVER' Config"

    config SET_RAW_ADV_DATA
        bool "Use raw data for advertising packets and scan response data"
        help
            If this config item is set, raw binary data will be used to generate advertising & scan response data.
            This option uses the esp_ble_gap_config_adv_data_raw() and esp_ble_gap_config_scan_rsp_data_raw()
            functions.

            If this config item is unset, advertising & scan response data is provided via a higher-level
            esp_ble_adv_data_t structure. The lower layer will generate the BLE packets. This option has higher
            overhead at runtime.

    config EXAMPLE_IPV4
        bool "IPV4"
        default y

    config EXAMPLE_IPV6
        bool "IPV6"
        default n
        select EXAMPLE_CONNECT_IPV6

    config EXAMPLE_PORT
        int "Port"
        range 0 65535
        default 3333
        help
            Local port the example server will listen on.

endmenu
```
